## main/Kconfig.projbuild
```kconfig
menu "Example Configuration"

    config ESP_WIFI_SSID
        string "WiFi SSID"
        default "myssid"
        help
            SSID (network name) for the example to connect to.

    config ESP_WIFI_PASSWORD
        string "WiFi Password"
        default "mypassword"
        help
            WiFi password (WPA or WPA2) for the example to use.

    config ESP_MAXIMUM_RETRY
        int "Maximum retry"
        default 5
        help
            Set the Maximum retry to avoid station reconnecting endlessly.

    config FULL_HOSTNAME
        string "Hostname"
        default "xmpp.dismail.de"
        help
            Hostname to get DNS A records for.

    config FULL_XMPP_SRV_HOST
        string "XMPP SRV Hostname"
        default "_xmpp-client._tcp.dismail.de"
        help
            Hostname to get DNS SRV records from.

    config PRIMARY_DNS_SERVER
        string "Primary DNS Server"
        default "8.8.8.8"
        help
            Hostname to get DNS SRV records from IPV4
endmenu
```
